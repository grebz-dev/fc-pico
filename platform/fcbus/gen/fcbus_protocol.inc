; SPDX-License-Identifier: BSD-3-Clause
;
; GENERATED by tools/gen_protocol.py from platform/fcbus/fcbus_protocol.h -- do not edit.
;
; --- mailbox: cartridge -> console, on the tail of every frame stream ---
PF_MAGIC_NO	EQU	$FC	; mailbox[1] validity sentinel (asm: PF_MAGIC_CODE)
PF_COM_NONE	EQU	$00	; end of command list
PF_COM_DMOD	EQU	$01	; blank display, enter bulk data mode
PF_COM_FDIN	EQU	$02	; palette fade in
PF_COM_FDOT	EQU	$03	; palette fade out
PF_COM_SE	EQU	$80	; 0x80|n play sound effect n
PF_COM_BGM	EQU	$A0	; 0xA0|n play music n
PF_COM_VRAM	EQU	$C0	; 0xC0|adrH, adrL, data: poke one VRAM byte
PF_DAT_VRAM	EQU	$80	; bulk data mode: VRAM block
PF_DAT_RAM	EQU	$81	; bulk data mode: CPU RAM block
PF_DAT_STEP	EQU	$82	; bulk data mode: leave and switch console step
FC_COM_BUF_SIZE16	EQU	16	; mailbox bytes the command executor parses (2..15)
FC_COM_BUF_SIZE	EQU	64	; mailbox length appended to every frame
PICO_SNDREG	EQU	$10	; offset of the APU (reg,value) pair area
PICO_APU_BUF_SIZE	EQU	$40	; depth of the firmware's APU write ring
APU_PAIRS_MAX	EQU	23	; pairs that fit: (64 - 16 - 2) / 2, terminator 0xFF
MBX_MAGIC	EQU	1	; byte 1: PF_MAGIC_NO
MBX_CMD	EQU	2	; bytes 2..15: command list, PF_COM_NONE terminated
MBX_APU	EQU	16	; bytes 16..: (reg,value) pairs, 0xFF terminated
FCBUS_ATTR_LEN	EQU	64	; attribute table $23C0-$23FF
FCBUS_BG_PAL_LEN	EQU	16	; background palette $3F00-$3F0F
FCBUS_PAL_LEN	EQU	32	; full palette $3F00-$3F1F
;
; --- opcodes: console -> cartridge, single bytes written to $2007 ---
FP_COM_ACK	EQU	$0F	; unused on both sides
FP_COM_NAK	EQU	$1F	; unused on both sides
FP_COM_VER	EQU	$2F	; request the 14-byte boot-ROM build stamp
FP_COM_ROM	EQU	$3F	; + page: request 256 bytes of the boot ROM image
FP_COM_LOG	EQU	$BF	; + up to 7 bytes: print on the cartridge serial console
FP_COM_DRQ	EQU	$CF	; bulk data mode: request next block header
FP_COM_DLD	EQU	$DF	; + page: bulk data mode: request one 256-byte page
FP_COM_RST	EQU	$EF	; restart the cartridge firmware
FP_COM_INI	EQU	$FF	; + stage: initialise the cartridge
;
; --- keys: controller byte bit layout ---
KEY_A	EQU	$80
KEY_B	EQU	$40
KEY_SEL	EQU	$20
KEY_RUN	EQU	$10	; Start
KEY_UP	EQU	$08
KEY_DOWN	EQU	$04
KEY_LEFT	EQU	$02
KEY_RIGHT	EQU	$01
;
; --- stream: frame stream geometry ---
PPU_PICTURE_COUNT	EQU	15426	; 66 pre-render + 240*64 visible qualifying reads
PPU_COUNTER_REPORT_BIAS	EQU	1	; fcppu_rna reports the zero-based index of the last read
PPU_COUNT_WINDOW	EQU	2	; +/- reads tolerated before the DMA is stopped
PPU_COUNT_VAL	EQU	15490	; 15490
VRAM_LINE_WORDS	EQU	34	; convVram() batch size; not the selected-read stride
VRAM_HEAD_WORDS	EQU	31	; word index of line 0, tile 0
VRAM_LINES	EQU	240
VRAM_TILE_COLS	EQU	32	; selected 16-bit words per visible scanline
VRAM_BUF_BYTES	EQU	17344	; 17344, DMA length in bytes
VRAM_MAILBOX_OFF	EQU	15426	; 15426: mailbox byte offset
FCBUS_VER_SYNC_W0	EQU	555819297	; "!!!!" pushed before the version stamp
FCBUS_VER_SYNC_W1	EQU	1128669985	; "!#FC" little-endian; the fix bank syncs on 'C'
FCBUS_ROM_STAMP_OFF	EQU	$6FF0	; stamp offset within the 32 KB PRG image ($EFF0)
FCBUS_ROM_STAMP_LEN	EQU	14	; bytes compared by CHK_ROMVER (16 streamed)
FCBUS_ROM_PRG_BYTES	EQU	$8000
FCBUS_ROM_INES_HDR	EQU	16
FCBUS_DRQ_MAGIC_BASE	EQU	$FC00	; drq_ret(): word0 = base + com + (adr << 16), word1 = size
;
; --- layout: descriptor version for generated layout consumers ---
FCBUS_LAYOUT_VERSION	EQU	1	; bump when a layout field changes meaning; readers reject unknown versions
;
; --- nesasm aliases (ASM_ALIAS in gen_protocol.py) ---
PF_MAGIC_CODE	EQU	PF_MAGIC_NO
